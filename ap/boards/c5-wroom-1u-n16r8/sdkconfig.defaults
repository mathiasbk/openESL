## ap/components/esl_lcd/Kconfig
```kconfig
# The status screen (esl_lcd.c), for the AP and for the radio coprocessor in ap/radio/.
# The symbols kept their names when they moved here from main/Kconfig.projbuild, so
# existing sdkconfig files still apply.
menu "OpenESL status screen"

menuconfig ESL_DISPLAY
    bool "Status on a small ST7789 LCD"
    default n
    help
        For ESP32-C6 boards with a 0.96" 160x80 ST7789 screen: shows the
        firmware version, channel, number of tags and how many are pending,
        the IP address or the setup network, and the uptime: in the AP
        (main/display.c), or in the radio coprocessor (ap/radio/), which shows
        what its AP host sends over UART. Off by
        default, so boards without a screen (the C6 Super Mini) are
        unchanged. The pins below are a guess for such boards (the
        Waveshare ESP32-C6-LCD layout); check them against your board.
        At start a frame is drawn around the edge for two seconds: if a
        side is missing or doubled, adjust the gaps.

if ESL_DISPLAY
    config ESL_LCD_WIDTH
        int "Width in pixels (as mounted)"
        default 160
    config ESL_LCD_HEIGHT
        int "Height in pixels (as mounted)"
        default 80
    config ESL_LCD_PIN_MOSI
        int "MOSI (SDA) GPIO"
        default 6
    config ESL_LCD_PIN_SCLK
        int "SCLK (SCL) GPIO"
        default 7
    config ESL_LCD_PIN_CS
        int "CS GPIO"
        default 14
    config ESL_LCD_PIN_DC
        int "DC GPIO"
        default 15
    config ESL_LCD_PIN_RST
        int "RST GPIO (-1 = none)"
        default 21
    config ESL_LCD_PIN_BL
        int "Backlight GPIO (-1 = always on)"
        default 22
    config ESL_LCD_BL_ON_LEVEL
        int "Backlight on level"
        range 0 1
        default 1
    choice ESL_LCD_ROTATION
        prompt "Rotation"
        default ESL_LCD_ROTATE_90
        config ESL_LCD_ROTATE_0
            bool "0 (portrait panel used as is)"
        config ESL_LCD_ROTATE_90
            bool "90 (landscape)"
        config ESL_LCD_ROTATE_270
            bool "270 (landscape, upside down)"
    endchoice
    config ESL_LCD_GAP_X
        int "Column offset into the controller's memory"
        default 1
        help
            0.96" 80x160 panels sit off-centre in the controller's RAM;
            1/26 (landscape) is the usual offset. Use the start-up frame
            to find it.
    config ESL_LCD_GAP_Y
        int "Row offset into the controller's memory"
        default 26
    config ESL_LCD_INVERT
        bool "Invert colours (IPS panels)"
        default y
    config ESL_LCD_BGR
        bool "BGR colour order"
        default y
    config ESL_LCD_REFRESH_MS
        int "Refresh interval (ms)"
        range 200 60000
        default 2000
endif

endmenu
```

## ap/main/Kconfig.projbuild
```kconfig
menu "OpenESL AP"

    config ESL_WIFI_SSID
        string "WiFi SSID"
        default ""
        help
            Used when NVS namespace "cfg" has no "ssid" key.

    config ESL_WIFI_PASSWORD
        string "WiFi password"
        default ""
        help
            Used when NVS namespace "cfg" has no "pass" key.

    config ESL_WIFI_SETUP_AFTER_S
        int "Open the setup network after this many s without WiFi (0 = never)"
        range 0 3600
        default 180
        help
            With no network saved, the AP opens its own network
            "openesl-XXXX" at once, with a setup page at
            http://192.168.4.1/setup. With one saved that has not given an IP
            for this long, it opens the setup network too, and keeps trying
            the saved one. The setup network closes a minute after joining.

    config ESL_WIFI_SETUP_PASSWORD
        string "Setup network password (empty = open network)"
        default ""
        help
            8 to 63 characters for WPA2, empty for an open network. The page
            itself asks for the API token once a token is set, so an open
            setup network only lets strangers configure an AP that has none.

    config ESL_WIFI_CAPTIVE
        bool "Captive portal on the setup network"
        default y
        help
            While the setup network is open, a DNS server answers every name
            with 192.168.4.1 and unknown pages redirect to the setup form, so
            a phone that joins the network shows its "sign in" page with the
            form in it. Without it, open http://192.168.4.1/setup by hand.

    config ESL_API_TOKEN
        string "API bearer token"
        default ""
        help
            Clients send "Authorization: Bearer <token>". Used when NVS
            namespace "cfg" has no "token" key. If empty, every API request
            is rejected with 401.

    config ESL_MDNS_HOSTNAME
        string "mDNS hostname"
        default "openesl"
        help
            Used when NVS namespace "cfg" has no "hostname" key. At the first
            start a new AP adds the suffix of its setup network (openesl-77c9,
            so two APs on one network get their own names); an AP that already
            has a network saved, or set in menuconfig, keeps this name as it is. Either is saved to
            cfg/hostname, so it does not change later.

    config ESL_WEB_DASHBOARD
        bool "Dashboard at /dashboard (the web page's Dashboard tab, served by the AP)"
        default y
        help
            The web page's dashboard, packed into the firmware from web/ at
            build time (main/webui.py, about 23 KB gzipped), so a browser on
            the network can use it without the bridge: an https page may not
            call the AP's plain http API, a page from the AP itself may.
            Its API calls need the token as usual.

    config ESL_WEB_DESIGNER
        bool "Design tab next to the dashboard (the web page's label designer)"
        depends on ESL_WEB_DASHBOARD
        default n
        help
            The web page's Design tab on the same page, packed the same way
            (about 125 KB more gzipped): it opens the layout files stored on
            this AP and saves them back to it (GET and PUT /api/layouts/...),
            and sends to a tag. Its renderer (WebAssembly) is packed too, built
            from the same sources as the firmware, so it needs no internet; build
            it first with python web/build.py --wasm (Emscripten). On for the
            boards with flash and PSRAM to spare.

    config ESL_STATUS_PAGE
        bool "Status page at / (no token)"
        default y
        help
            A read-only HTML table of all tags (MAC, model, last seen,
            battery, content). It needs no token, so anyone on the network
            can read it. The /api/ endpoints always need the token.

    config ESL_SERIAL_API
        bool "API over the USB serial port"
        default y
        depends on ESP_CONSOLE_USB_SERIAL_JTAG
        help
            The same API as over HTTP, framed as "@ESL ..." lines on the
            built-in USB port next to the log (tools/esl-client --serial).
            Needs no token: whoever has the cable has the device.

    config ESL_CHANNEL
        int "802.15.4 channel"
        range 11 26
        default 25

    config ESL_PAN_ID
        hex "802.15.4 PAN ID"
        range 0x0000 0xFFFE
        default 0x4553

    config ESL_NEXT_POLL_S
        int "Default poll interval in s sent to tags (0 = tag keeps its own)"
        range 0 3600
        default 0
        help
            Built-in default for tags without their own poll_s. PUT /api/config
            overrides it at run time (stored in NVS cfg/poll_s), and
            PUT /api/tags/{mac}/config sets it per tag. Values other than 0
            should be 10..3600, the range the API accepts.

    config ESL_MAX_TAGS
        int "Max tags per AP"
        range 20 4096
        default 1000
        help
            Most tags the AP keeps. The table grows 32 tags at a time as tags
            turn up, about 88 bytes of RAM per tag (PSRAM when the board has
            it), and stops growing while it would leave too little internal
            RAM free (main/store_nvs.c), whatever this says. A tag's content is in NVS
            only: up to about 400 bytes per tag with content, settings and
            its last poll, so the 468 KB NVS partition holds about 1000. The
            API replies that list every tag are streamed, so they do not
            grow with this. See "How many tags" in README.md, also for what
            the radio takes.

    config ESL_MAX_SCHEDULED
        int "Max scheduled content entries"
        range 0 1000
        default 256
        help
            Room for content that takes effect at a given time ("at" in
            PUT /api/tags). Each entry costs 16 bytes of RAM and up to about
            160 bytes of NVS while it waits. 0 turns scheduling and the
            clock (/api/time, /api/schedule) off.

    config ESL_NTP_SERVER
        string "NTP server"
        default "pool.ntp.org"
        depends on ESL_MAX_SCHEDULED > 0
        help
            Where the AP gets the time once it is on WiFi. Empty: no NTP;
            the time then only comes from PUT /api/time.
    config ESL_DATASOURCES
        bool "Data sources: the AP fetches content itself (weather from MET Norway)"
        depends on ESL_MAX_SCHEDULED > 0
        default n
        help
            GET/PUT /api/sources: sources the AP reads every so often over
            HTTPS, such as the forecast for a place from api.met.no, and
            turns into the content of the tags given to each source, in a
            layout from the layout files ("{temp}°" in a field). Content
            that comes out the same is not sent again. Needs the clock
            (NTP) and about 40 KB of RAM for TLS while it fetches, so it is
            on for the boards with PSRAM.

    config ESL_WEBHOOK
        bool "Webhook: post the health report when it changes"
        default y
        help
            PUT /api/config {"webhook": "http://..."} makes the AP POST the
            report of GET /api/health (tags that are silent, never seen,
            failed to draw, low on battery, rejected the layout file, or
            cannot get their content) to that URL whenever any tag's
            problems change. Off: /api/config answers 422 for "webhook".

    config ESL_HEALTH_PERIOD_S
        int "Seconds between health checks for the webhook"
        depends on ESL_WEBHOOK
        range 5 3600
        default 30

    config ESL_OTA
        bool "OTA: new AP firmware through POST /api/ota"
        default y
        help
            The app image (build/esl_ap.bin, openesl-ap-ota.bin in a
            release) is written to the app slot that is not running, which
            becomes the boot slot; the AP restarts and the bootloader goes
            back to the old slot if the new image does not come up, or
            (with a WiFi network to join) gets neither a WiFi address nor
            an API request within three minutes.
            Needs the two-slot partition table (ap/partitions.csv) on a
            4 MB flash. Off: POST /api/ota answers 501.

    config ESL_TX_POWER_DBM
        int "802.15.4 TX power (dBm)"
        range -24 20
        default 10
        help
            The built-in value; PUT /api/config "tx_power" sets another, kept in
            NVS. The C6 gives up to 20 dBm, more than the EU allows: EN 300 328
            allows 20 dBm EIRP and 10 dBm/MHz at 2.4 GHz, which for 802.15.4 (about
            2 MHz wide) comes to about 13 dBm with an antenna of up to 0 dBi, such
            as a chip or PCB antenna. With an external antenna of G dBi, the EU
            limit is about 13 - G. More power reaches
            tags further away, but their answers do not get stronger: for those, a
            better antenna on the AP helps.

    choice ESL_RADIO_MODE
        prompt "Radio mode"
        default ESL_RADIO_AP

        config ESL_RADIO_AP
            bool "AP: answer tag polls"
        config ESL_RADIO_SNIFFER
            bool "Sniffer: log every frame on the channel, do not answer"
        config ESL_RADIO_STUB
            bool "Stub: no radio, simulated tags poll the store"
    endchoice

    choice ESL_RADIO_DRIVER
        prompt "Radio driver"
        depends on !ESL_RADIO_STUB
        default ESL_RADIO_DRIVER_IEEE802154
        help
            The link the AP reaches its tags through (esl_link.h in
            components/esl_core). radio.c, the radio task, is the same
            for every driver.

        config ESL_RADIO_DRIVER_IEEE802154
            bool "802.15.4 radio of this chip (ESP32-C6, ESP32-C5)"
            depends on SOC_IEEE802154_SUPPORTED
        config ESL_RADIO_DRIVER_UART
            bool "802.15.4 radio coprocessor on UART (an ESP32-C6 running ap/radio/)"
            help
                For a chip without 802.15.4 (the ESP32-S3 in boards/s3-n16r8-c6): a
                C6 running the firmware in ap/radio/ does the radio, and this chip
                answers the tags through it (docs/ap-radio-link.md).
        config ESL_RADIO_DRIVER_NET
            bool "802.15.4 radio over WiFi (an ESP32-C6 running ap/netradio/)"
            depends on ESL_RADIO_AP
            help
                The radio is a C6 elsewhere on the same WiFi network, which answers
                the tags from its own cache and syncs with this AP over TCP
                (docs/ap-netradio.md: read its limits first). Not secure yet: any
                device on the network can connect as the radio.
    endchoice

    config ESL_NETRADIO_PORT
        int "Radio over WiFi: TCP port"
        depends on ESL_RADIO_DRIVER_NET
        range 1 65535
        default 4553

    config ESL_COPROC_UART_NUM
        int "Radio coprocessor: UART"
        depends on ESL_RADIO_DRIVER_UART
        range 1 2
        default 1

    config ESL_COPROC_TX_GPIO
        int "Radio coprocessor: TX pin (to the radio's RX)"
        depends on ESL_RADIO_DRIVER_UART
        default 17

    config ESL_COPROC_RX_GPIO
        int "Radio coprocessor: RX pin (from the radio's TX)"
        depends on ESL_RADIO_DRIVER_UART
        default 18

    config ESL_SNIFFER_HOP_MS
        int "Sniffer: hop through channels 11-26, ms per channel (0 = stay on ESL_CHANNEL)"
        depends on ESL_RADIO_SNIFFER
        range 0 10000
        default 0
        help
            For finding a device whose channel is unknown, such as a stock
            SoluM remote. After a frame is heard the sniffer stays on that
            channel for 10 s before it hops on.

    config ESL_STUB_TAGS
        int "Simulated tags"
        depends on ESL_RADIO_STUB
        range 1 16
        default 3

    config ESL_STUB_INTERVAL_S
        int "Simulated poll interval (s)"
        depends on ESL_RADIO_STUB
        range 1 600
        default 10

endmenu
```

## ap/netradio/main/Kconfig.projbuild
```kconfig
menu "OpenESL radio over WiFi"

    config ESL_TX_POWER_DBM
        int "802.15.4 TX power (dBm)"
        range -24 20
        default 10

    config ESL_CHANNEL
        int "802.15.4 channel until the AP says"
        range 11 26
        default 25
        help
            The AP sends its channel and PAN when the radio connects; the radio keeps
            the last ones in NVS and starts on them.

    config ESL_PAN_ID
        hex "802.15.4 PAN ID until the AP says"
        range 0x0000 0xFFFE
        default 0x4553

    config ESL_NETRADIO_PORT
        int "The AP's TCP port, when it is set by address (host in the console)"
        range 1 65535
        default 4553

    config ESL_NETRADIO_TAGS
        int "Tags the radio holds state for"
        range 16 2000
        default 500

    config ESL_NETRADIO_IMAGES
        int "Images the radio holds"
        range 1 32
        default 8

    config ESL_NETRADIO_LOG
        int "Frames the log holds between syncs"
        range 16 1024
        default 128

endmenu
```
